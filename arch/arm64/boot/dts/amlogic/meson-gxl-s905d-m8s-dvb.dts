// SPDX-License-Identifier: (GPL-2.0+ OR MIT)
/*
 * Author: afl1 <afl2001@gmail.com>
 */

#include "meson-gxl-s905d-ki-plus.dts"
/ {
	model = "MeCool M8S Plus DVB-T2/T";

	dvb {
		dev_name = "avl6762";
	};
};
