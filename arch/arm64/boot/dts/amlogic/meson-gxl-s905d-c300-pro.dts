// SPDX-License-Identifier: (GPL-2.0+ OR MIT)
/*
 * Author: afl1 <afl2001@gmail.com>
 */

#include "meson-gxl-s905d-ki-plus.dts"
/ {
	model = "Magicsee C300 PRO DVB-T2/S2/C";

	dvb {
		dev_name = "avl6762";
		fec_reset_gpio-gpios0 = <&gpio GPIOZ_2 GPIO_ACTIVE_HIGH>;
		power_ctrl_gpio-gpios0 = <&gpio_ao GPIOAO_6 GPIO_ACTIVE_LOW>;
	};
};
&i2c_C {
	status = "okay";
	clock-frequency = <300000>;
};
